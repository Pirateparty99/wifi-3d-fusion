## templates/Kconfig.projbuild
```kconfig
config SEND_CSI_TO_UDP
        depends on SHOULD_COLLECT_CSI
        bool "Send CSI data to UDP (WiFi-3D-Fusion compatible)"
        default "n"
        help
            Sends CSI data as JSON over UDP, matching the payload format expected
            by WiFi-3D-Fusion's esp32_udp.py receiver.
    config UDP_TARGET_IP
        depends on SEND_CSI_TO_UDP
        string "UDP target IP address"
        default "192.168.1.100"
        help
            IP address of the host machine running WiFi-3D-Fusion.
    config UDP_TARGET_PORT
        depends on SEND_CSI_TO_UDP
        int "UDP target port"
        default 5566
        help
            UDP port WiFi-3D-Fusion's esp32_udp.py listens on (must match
            esp32_udp_port in configs/fusion.yaml).
```
